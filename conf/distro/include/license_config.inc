## conf/distro/include/license_config.inc
```bitbake
# Correct license listings across various packages based on changes made
# to upstream oe-core.

# openembedded-core layer
LICENSE_pn-acpica = "Intel | BSD-3-Clause | GPLv2"
LICENSE_pn-dtc = "GPLv2 | BSD-2-Clause"
LICENSE_pn-e2fsprogs = "GPLv2 & LGPLv2 & BSD-3-Clause & MIT"
LICENSE_pn-font-util = "MIT & MIT-style & BSD-4-Clause & BSD-2-Clause"
LICENSE_pn-flac = "GFDL-1.2 & GPLv2+ & LGPLv2.1+ & BSD-3-Clause"
LICENSE_pn-ffmpeg = "GPLv2+ & LGPLv2.1+ & ISC & Expat & BSD-2-Clause & BSD-3-Clause & IJG"
LICENSE_pn-glib-2.0 = "LGPLv2.1+ & BSD-3-Clause & PD"
LICENSE_pn-hdparm = "BSD-2-Clause & GPLv2 & hdparm"
LICENSE_${PN}_forcevariable_pn-hdparm = "BSD-2-Clause & GPLv2 & hdparm"
LICENSE_${PN}-dbg_forcevariable_pn-hdparm = "BSD-2-Clause & GPLv2 & hdparm"
LICENSE_pn-iputils = "BSD-3-Clause & GPLv2+"
LICENSE_pn-libcap = "BSD-3-Clause | GPLv2"
LICENSE_pn-libevent = "BSD-3-Clause & MIT"
LICENSE_pn-libpam = "GPLv2+ | BSD-3-Clause"
LICENSE_pn-libjitterentropy = "GPLv2+ | BSD-3-Clause"
LICENSE_pn-libwpe = "BSD-2-Clause"
LICENSE_pn-libxfont = "MIT & MIT-style & BSD-3-Clause"
LICENSE_pn-libxfont2 = "MIT & MIT-style & BSD-4-Clause & BSD-2-Clause"
LICENSE_pn-libx11 = "MIT & MIT-style & BSD-1-Clause & HPND & HPND-sell-variant"
LICENSE_pn-libx11-compose-data = "MIT & MIT-style & BSD-1-Clause & HPND & HPND-sell-variant"
LICENSE_pn-lsof = "Spencer-94"
LICENSE_pn-lz4 = "BSD-2-Clause | GPL-2.0"
LICENSE_pn-nfs-utils = "MIT & GPLv2+ & BSD-3-Clause"
LICENSE_pn-openssh = "BSD-2-Clause & BSD-3-Clause & BSD-4-Clause & ISC & MIT"
LICENSE_pn-ovmf = "BSD-2-Clause-Patent"
LICENSE_pn-ppp = "BSD-3-Clause & BSD-3-Clause-Attribution & GPLv2+ & LGPLv2+ & PD"
LICENSE_pn-python-async-test = "BSD-3-Clause"
LICENSE_pn-python3-numpy = "BSD-3-Clause & BSD-2-Clause & PSF & Apache-2.0 & MIT"
LICENSE_pn-python3-packaging = "Apache-2.0 | BSD-2-Clause"
LICENSE_pn-quota = "GPLv2+ & LGPLv2.1+"
LICENSE_pn-shadow = "BSD-3-Clause | Artistic-1.0"
LICENSE_pn-sudo = "ISC & BSD-3-Clause & BSD-2-Clause & Zlib"
LICENSE_pn-swig = "BSD-3-Clause & GPLv3"
LICENSE_pn-tzdata = "PD & BSD-3-Clause"
LICENSE_pn-valgrind = "GPLv2 & GPLv2+ & BSD-3-Clause"
LICENSE_pn-webkitgtk = "BSD-2-Clause & LGPLv2+"
LICENSE_pn-wpebackend-fdo = "BSD-2-Clause"
LICENSE_pn-xinetd = "xinetd"

NO_GENERIC_LICENSE[hdparm] = "LICENSE.TXT"

# meta-openembedded layer
LICENSE_pn-autossh = "BSD-1-Clause & BSD-4-Clause"
LICENSE_pn-dash = "BSD-3-Clause & GPLv2+"
LICENSE_pn-gnome-backgrounds = "GPL-2.0-only & CC-BY-2.0 & CC-BY-SA-2.0 & CC-BY-SA-3.0"
LICENSE_pn-gpsd-machine-conf = "BSD-3-Clause"
LICENSE_pn-imlib2 = "Imlib2"
LICENSE_pn-jemalloc = "BSD-2-Clause"
LICENSE_pn-libkcapi = "BSD-3-Clause | GPL-2.0"
LICENSE_pn-nodejs = "MIT & ISC & BSD-2-Clause & BSD-3-Clause & Artistic-2.0"
LICENSE_pn-pcsc-lite = "BSD-3-Clause & GPLv3+"
LICENSE_${PN}_forcevariable_pn-pcsc-lite = "BSD-3-Clause"
LICENSE_${PN}-lib_forcevariable_pn-pcsc-lite = "BSD-3-Clause"
LICENSE_${PN}-doc_forcevariable_pn-pcsc-lite = "BSD-3-Clause"
LICENSE_${PN}-dev_forcevariable_pn-pcsc-lite = "BSD-3-Clause"
LICENSE_${PN}-dbg_forcevariable_pn-pcsc-lite = "BSD-3-Clause & GPLv3+"
LICENSE_pn-python3-aenum = "BSD-3-Clause"
LICENSE_pn-python3-cryptography = "Apache-2.0 | BSD-3-Clause"
LICENSE_pn-python3-cryptography-vectors = "Apache-2.0 | BSD-3-Clause"
LICENSE_pn-python3-cycler = "BSD-3-Clause"
LICENSE_pn-python3-dill = "BSD-3-Clause"
LICENSE_pn-python3-flask-bootstrap = "Apache-2.0 & MIT & BSD-3-Clause"
LICENSE_pn-python3-geojson = "BSD-3-Clause"
LICENSE_pn-python3-gevent = "MIT & Python-2.0"
LICENSE_pn-python3-gnupg = "BSD-3-Clause"
LICENSE_pn-python3-jdcal = "BSD-2-Clause"
LICENSE_pn-python3-ipython = "BSD-3-Clause"
LICENSE_pn-python3-ipython-genutils = "BSD-3-Clause"
LICENSE_pn-python3-kiwisolver = "BSD-3-Clause"
LICENSE_pn-python3-lxml = "BSD-3-Clause & GPLv2 & MIT & PSF"
LICENSE_pn-python3-mpmath = "BSD-3-Clause"
LICENSE_pn-python3-parallax = "BSD-3-Clause"
LICENSE_pn-python3-posix-ipc = "BSD-3-Clause"
LICENSE_pn-python3-pyperclip = "BSD-3-Clause"
LICENSE_pn-python3-pyzmq = "BSD-3-Clause & LGPL-3.0"
LICENSE_pn-python3-send2trash = "BSD-3-Clause"
LICENSE_pn-python3-sqlparse = "BSD-3-Clause"
LICENSE_pn-python3-sympy = "BSD-3-Clause"
LICENSE_pn-python3-traitlets = "BSD-3-Clause"
LICENSE_pn-python3-webencodings = "BSD-3-Clause"
LICENSE_pn-sg3-utils = "GPLv2+ & BSD-2-Clause"
LICENSE_pn-xmlrpc-c = "BSD-3-Clause & MIT"
```

## conf/layer.conf
```bitbake
# We have a conf and classes directory, add to BBPATH
BBPATH .= ":${LAYERDIR}"

# We have recipes-* directories, add to BBFILES
BBFILES += " \
    ${LAYERDIR}/recipes-*/*/*.bb \
    ${LAYERDIR}/recipes-*/*/*.bbappend \
    "

BBFILE_PATTERN_IGNORE_EMPTY_sls-sbom = "1"

BBFILE_COLLECTIONS += "sls-sbom"
BBFILE_PATTERN_sls-sbom = "^${LAYERDIR}/"
BBFILE_PRIORITY_sls-sbom = "5"
LAYERVERSION_sls-sbom = "1"
LAYERSERIES_COMPAT_sls-sbom = "wrl hardknott dunfell gatesgarth zeus warrior thud sumo rocko pyro morty honister kirkstone langdale"

LAYERDEPENDS_sls-sbom = " \
    core \
    "

# extra licenses not found in other layers can be found here
LICENSE_PATH += "${LAYERDIR}/meta/files/common-licenses"

export WRSBOM_LAYER = "${LAYERDIR}"

SBOM_CPE ?= "0"
SBOM_PURL ?= "1"
SBOM_license ?= "1"
SBOM_externalDocumentRefs ?= "0"

INHERIT += 'sls-create-spdx'
```
